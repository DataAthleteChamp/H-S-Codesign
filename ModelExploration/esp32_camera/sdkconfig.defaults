## ModelExploration/esp32_camera/sdkconfig.defaults
```kconfig
CONFIG_IDF_TARGET="esp32s3"
CONFIG_SPIRAM=y
CONFIG_SPIRAM_MODE_OCT=y
CONFIG_ESP_MAIN_TASK_STACK_SIZE=65536
CONFIG_PARTITION_TABLE_SINGLE_APP_LARGE=y
```
